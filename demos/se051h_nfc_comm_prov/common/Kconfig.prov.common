## demos/se051h_nfc_comm_prov/common/Kconfig.prov.common
```kconfig
#
# Copyright 2026 NXP
# SPDX-License-Identifier: BSD-3-Clause
config SE05X_DO_RESET
	bool "Delete all provisioned data (QR code is not deleted)"
	default n
	help
		Delete all provisioned data except QR code.

config SE05X_DO_EC_KEY_PROVISION
	bool "Provision EC key"
	default n
	help
		Enable EC key provisioning.

config SE05X_DO_USER_ID_PROVISION
	bool "Provision User ID"
	default n
	help
		Enable User ID provisioning.

config SE05X_DO_AES_KEY_PROVISION
	bool "Provision AES key"
	default n
	help
		Enable AES key provisioning.

config SE05X_ONLY_T4T_PROVISION
	bool "Provision only QR code in T4T applet"
	default n
	help
		Provision only QR code in T4T applet.

config SE05X_TP_SPAKE_PASSCODE_SET_NO
	int "Trust Provisioned pass-code set number"
	range 1 3
	default 1
	help
		Trust Provisioned pass-code set to be used (Possible values 1, 2, 3).

config SE05X_TP_SPAKE_ITER_TO_BE_USED
	int "Trust Provisioned iteration count"
	default 1000
	help
		Trust Provisioned iteration count to be used.
		Possible values: 1000, 5000, 10000, 50000, 100000.

choice SE05X_DEVICE_NETWORK_TYPE
	prompt "Device network interface type"
	default SE05X_DEVICE_NETWORK_TYPE_WIFI
	help
		Select the network interface type for NFC commissioning.

config SE05X_DEVICE_NETWORK_TYPE_WIFI
	bool "WiFi network interface"
	help
		Enable WiFi network interface for NFC commissioning.

config SE05X_DEVICE_NETWORK_TYPE_THREAD
	bool "Thread network interface"
	help
		Enable Thread network interface for NFC commissioning.

config SE05X_DEVICE_NETWORK_TYPE_ETHERNET
	bool "Ethernet network interface"
	help
		Enable Ethernet network interface for NFC commissioning.

endchoice

config SE05X_PROVISION_WITH_POLICY
	bool "Provision with policy"
	default n
	help
		Enable provisioning with policy.

config SE05X_PROVISION_VERIFIERS
	bool "Provision Verifiers"
	default n
	help
		Enable provisioning Verifiers.

config SE05X_DO_READIDLIST
	bool "Read ID list from SE05x"
	default n
	help
		Read ID list from SE05x.
```

## demos/se051h_nfc_comm_prov/mcu/Kconfig
```kconfig
#
# Copyright 2025-2026 NXP
# SPDX-License-Identifier: BSD-3-Clause

mainmenu "SE05X nfc commissioning example"

rsource "../common/Kconfig.prov.common"
rsource "../../../matter/se05x_demos_common/Kconfig.se05x.common"
```

## demos/se051h_nfc_comm_prov/zephyr/Kconfig
```kconfig
#
# Copyright 2026 NXP
# SPDX-License-Identifier: BSD-3-Clause

rsource "../../../../../../config/nxp/cmake/Kconfig.matter.nxp"
rsource "../../../../../../third_party/simw-top-mini/repo/matter/zephyr/Kconfig"
rsource "../common/Kconfig.prov.common"

# Secure Element
config CHIP_SE05X
	bool "Enable Secure Element support"
	select SE05X_LIB
	help
		Use Secure Element to perform crypto operations.

config CHIP_TASK_STACK_SIZE
	int "Matter task stack size"
	default 13312
	help
	  Set the stack size (in bytes) for the Matter main task (CHIP event loop).
```

## demos/se05x_dev_attest_key_prov/mcu/Kconfig
```kconfig
#
# Copyright 2025 NXP
# SPDX-License-Identifier: BSD-3-Clause

mainmenu "SE05X Device attestation provisioning example"

rsource "../../../matter/se05x_demos_common/Kconfig.se05x.common"
```

## demos/se05x_get_passcode/mcu/Kconfig
```kconfig
#
# Copyright 2025-2026 NXP
# SPDX-License-Identifier: BSD-3-Clause

mainmenu "SE05X get passcode example"

config SE05X_TP_SPAKE_PASSCODE_SET_NO
	int "Trust Provisioned pass-code set number"
	range 1 3
	default 1
	help
		To get Trust Provisioned pass-code (Possible values 1, 2, 3).

rsource "../../../matter/se05x_demos_common/Kconfig.se05x.common"
```

## matter/Kconfig
```kconfig
#
# Copyright 2025-2026 NXP
# SPDX-License-Identifier: BSD-3-Clause
#

# Secure Element
config SE05X_LIB
	bool "Enable Secure Element library"
	select MCUX_COMPONENT_driver.flexcomm_i2c if MCUX_HW_DEVICE_RW612 || MCUX_HW_DEVICE_RW610
	select MCUX_COMPONENT_driver.flexcomm_i2c_freertos if MCUX_HW_DEVICE_RW612 || MCUX_HW_DEVICE_RW610
	select MCUX_COMPONENT_driver.lpi2c if MCUX_HW_DEVICE_MIMXRT1062 || MCUX_HW_DEVICE_MCXW727C
	select MCUX_COMPONENT_driver.lpi2c_freertos if MCUX_HW_DEVICE_MIMXRT1062 || MCUX_HW_DEVICE_MCXW727C
	help
		Use Secure Element library

if SE05X_LIB

config NXP_CRYPTO_IMPL
	string "NXP SE05X Crypto Implementation"
	default "se05x"
	help
		Defines crypto implementation to be used

config SE05X_SCP03
	bool "Enable platform SCP03 authenticated session with SE05x"
	depends on SE05X_LIB
	help
		To enable platform SCP03 authenticated session with SE05x

config SE05X_USER_ID
	bool "Enable User ID authenticated session with SE05x"
	depends on SE05X_LIB
	help
		To enable User ID authenticated session with SE05x

config SE05X_AES_KEY
	bool "Enable AES Key authenticated session with SE05x"
	depends on SE05X_LIB
	help
		To enable AES Key authenticated session with SE05x

config SE05X_EC_KEY
	bool "Enable EC Key authenticated session with SE05x"
	depends on SE05X_LIB
	help
		To enable EC Key authenticated session with SE05x

config SE05X_SCP03_USER_ID
	bool "Enable SCP03 + USer ID authenticated session with SE05x"
	depends on SE05X_LIB
	help
		To enable SCP03 + USer ID authenticated session with SE05x

config SE05X_SCP03_AES_KEY
	bool "Enable SCP03 + AES Key authenticated session with SE05x"
	depends on SE05X_LIB
	help
		To enable SCP03 + AES Key authenticated session with SE05x

config SE05X_SCP03_EC_KEY
	bool "Enable SCP03 + EC Key authenticated session with SE05x"
	depends on SE05X_LIB
	help
		To enable SCP03 + EC Key authenticated session with SE05x

config SE05X_HOST_GPIO
	bool "Host controller SE05x GPIO enablement"
	depends on MCUX_HW_DEVICE_RW612 || MCUX_HW_DEVICE_RW610 || MCUX_HW_DEVICE_MIMXRT1062
	help
		NXP Host controller SE05x GPIO enablement

endif # SE05X_LIB
```

## matter/se05x_demos_common/Kconfig.se05x.common
```kconfig
#
# Copyright 2025 NXP
# SPDX-License-Identifier: BSD-3-Clause

mainmenu "SE05X examples"

# Secure Element
config CHIP_SE05X
	bool "Enable Secure Element support"
	select SE05X_LIB
	select MCUX_COMPONENT_middleware.mbedtls3x if SE05X_SCP03 || SE05X_USER_ID || SE05X_AES_KEY || SE05X_EC_KEY || SE05X_SCP03_USER_ID || SE05X_SCP03_AES_KEY || SE05X_SCP03_EC_KEY
	help
		Use Secure Element to perform crypto operations.

# Include defaults for SDK Kconfig
config MCUX_PRJSEG_module.board.use_board_clock
    bool
    default n

config MCUX_HAS_PRJSEG_module.board.pinmux_sel
    bool
    default n

choice MCUX_PRJSEG_module.board.pinmux_sel
    default MCUX_PRJSEG_module.board.pinmux_customize_folder
endchoice

config MCUX_HAS_PRJSEG_project.use_hw_app
    bool
    default n

choice MCUX_PRJSEG_project.hw_app_sel
    default MCUX_PRJSEG_project.hw_app_customize_folder
endchoice

config MCUX_COMPONENT_SIMW_LIB_MODULE
   default y if CHIP_SE05X
   default n

config MATTER_DEFAULT_LINKER_FILE_PATH
	string "Default linker file path for Matter applications"
	default "$(CHIP_ROOT)/third_party/nxp/nxp_matter_support/examples/platform/rt/rw61x/app/ldscripts/RW610_flash.ld" if MCUX_HW_DEVICE_RW612 || MCUX_HW_DEVICE_RW610
	default "$(CHIP_ROOT)/third_party/nxp/nxp_matter_support/examples/platform/rt/rt1060/app/ldscripts/MIMXRT1062xxxxx_flexspi_nor.ld" if MCUX_HW_DEVICE_MIMXRT1062
	default "${SdkRootDirPath}/examples/_boards/frdmmcxw72/wireless_examples/linker/gcc/connectivity.ld" if MCUX_HW_DEVICE_MCXW727C
	help
		Defines the path to the linker file to use.

config CHIP_NXP_RT1060_SDK_DEPENDENCIES
    bool "RT1060 SDK DEPENDENCIES"
    depends on MCUX_HW_DEVICE_MIMXRT1061 || MCUX_HW_DEVICE_MIMXRT1062
	default y
	select MCUX_COMPONENT_component.timer_manager
	select MCUX_COMPONENT_component.igpio_adapter
	select MCUX_COMPONENT_driver.edma
	select MCUX_COMPONENT_middleware.sdmmc.common
	select MCUX_COMPONENT_middleware.sdmmc.host.usdhc
	select MCUX_COMPONENT_middleware.sdmmc.sdio
	select MCUX_COMPONENT_component.wifi_bt_module.config
	select MCUX_COMPONENT_middleware.mbedtls3x.port.tfm # Required for entropy
    help
        NXP RT1060 platform sdk dependencies.

config CHIP_NXP_RW612_SDK_DEPENDENCIES
    bool "RW612 SDK DEPENDENCIES"
    depends on MCUX_HW_DEVICE_RW612 || MCUX_HW_DEVICE_RW610
	default y
	select MCUX_COMPONENT_middleware.freertos-kernel.cm33_non_trustzone
	select MCUX_COMPONENT_middleware.mbedtls3x.port.tfm # Required for entropy
    help
        NXP RW612 platform sdk dependencies.

config CHIP_NXP_PLATFORM_RW61X
	bool "RW61x platform"
	depends on MCUX_HW_DEVICE_RW612 || MCUX_HW_DEVICE_RW610
	default y
	help
		NXP RW61x platform.

config CHIP_NXP_PLATFORM_MCXW72
	bool "mcxw72 platform"
	depends on MCUX_HW_DEVICE_MCXW727C
	default y
	help
		NXP mcxw72 platform.

config CHIP_NXP_MCXW72_SDK_DEPENDENCIES
    bool "MCXW72 SDK DEPENDENCIES"
    depends on MCUX_HW_DEVICE_MCXW727C
	default y
	select MCUX_COMPONENT_middleware.freertos-kernel.cm33_non_trustzone
	select MCUX_COMPONENT_component.led
	select MCUX_COMPONENT_component.button
	select MCUX_COMPONENT_component.timer_manager
	select MCUX_COMPONENT_component.gpio_adapter
	select MCUX_COMPONENT_component.lptmr_time_stamp_adapter
	select MCUX_COMPONENT_driver.lpspi
	select MCUX_COMPONENT_middleware.wireless.ble_host
	select MCUX_COMPONENT_middleware.wireless.framework
	select MCUX_COMPONENT_component.messaging
	select MCUX_COMPONENT_middleware.wireless.framework.seclib_rng
	select MCUX_COMPONENT_middleware.wireless.framework.module_info
	select MCUX_COMPONENT_middleware.wireless.framework.function_lib
	select MCUX_COMPONENT_middleware.wireless.framework.module_info
	select MCUX_COMPONENT_middleware.wireless.framework.hw_parameter
	select MCUX_COMPONENT_middleware.wireless.framework.lowpower
	select MCUX_COMPONENT_middleware.wireless.framework.workq
	select MCUX_COMPONENT_middleware.mbedtls3x
	select MCUX_COMPONENT_component.flash_nor_lpspi
	select MCUX_COMPONENT_middleware.mbedtls3x.port.tfm # Required for entropy
	select MCUX_COMPONENT_component.psa_crypto_driver.ele_s200
    help
        NXP MCXW72 platform sdk dependencies.

config CHIP_SDK_DEPENDENCIES_BLE_HOST
	bool "SDK dependencies for BLE host implementation"
	default y if CHIP_NXP_PLATFORM_MCXW72
	help
	    SDK dependencies for BLE host implementation.

config MCUX_PRJSEG_module.board.matter.board
	bool "Enable board files"
	default y
	help
		Enables the inclusion of board files in the application build.

config CHIP_NXP_PLATFORM_RT1060
	bool "RT1060 platform"
	depends on MCUX_HW_DEVICE_MIMXRT1061 || MCUX_HW_DEVICE_MIMXRT1062
	default y
	help
		NXP RT1060 platform.

config CHIP_WIFI
	bool "Enable Wi-Fi support"
	default y if MCUX_HW_BOARD_evkcmimxrt1060
	help
		Enable Wi-Fi support.

# Enable IW61X transceiver by default
choice MCUX_DEPENDENCY_COMPONENT_component.wifi_bt_module.selection
	default MCUX_COMPONENT_component.wifi_bt_module.IW61X if MCUX_HW_BOARD_evkcmimxrt1060
endchoice

#IW612 transceiver module type
if MCUX_COMPONENT_component.wifi_bt_module.IW61X
choice IW61X_MDOULE
	default MCUX_COMPONENT_component.wifi_bt_module.board_murata_2el_m2
endchoice
endif

config CHIP_NXP_PLATFORM_FOLDER_NAME
	string "NXP platform folder name"
	default "rt/rw61x" if MCUX_HW_DEVICE_RW612 || MCUX_HW_DEVICE_RW610
	default "rt/rt1060" if MCUX_HW_DEVICE_MIMXRT1061 || MCUX_HW_DEVICE_MIMXRT1062
	default "mcxw72" if MCUX_HW_DEVICE_MCXW727C
	help
		Defines the platform folder name to be used.
# FreeRTOS defaults
config configTICK_RATE_HZ
	default 1000

config configMAX_PRIORITIES
	default 10

config configRUN_FREERTOS_SECURE_ONLY
	default y

config configTIMER_QUEUE_LENGTH
	default 10

config configAPPLICATION_ALLOCATED_HEAP
	default y

config configCHECK_FOR_STACK_OVERFLOW
	default y

config configTIMER_TASK_PRIORITY
	default "(configMAX_PRIORITIES - 3)"

config configTOTAL_HEAP_SIZE
	default 129024

config configMINIMAL_STACK_SIZE
	default 2048

# This Kconfig requires quotes "" due to its definition as a string
config configTIMER_TASK_STACK_DEPTH
	default "2048"

config configRECORD_STACK_HIGH_ADDRESS
	default y

config configINCLUDE_FREERTOS_TASK_C_ADDITIONS_H
	default y

config configENABLE_FPU
	default y

config configMAX_TASK_NAME_LEN
	default 16

config configSUPPORT_STATIC_ALLOCATION
	default y

config configNUM_THREAD_LOCAL_STORAGE_POINTERS
	default 0

config configSTACK_DEPTH_TYPE
	default "StackType_t"

config INCLUDE_uxTaskGetStackHighWaterMark2
	default n

config INCLUDE_xTaskGetIdleTaskHandle
	default n

config INCLUDE_eTaskGetState
	default n

config INCLUDE_xTaskGetHandle
	default n

config configKERNEL_PROVIDED_STATIC_MEMORY
	default y

if SE05X_SCP03 || SE05X_USER_ID || SE05X_AES_KEY || SE05X_EC_KEY || SE05X_SCP03_USER_ID || SE05X_SCP03_AES_KEY || SE05X_SCP03_EC_KEY || MCUX_HW_DEVICE_MCXW727C
	choice MCUX_COMPONENT_middleware.mbedtls.port.selection
		default MCUX_COMPONENT_middleware.mbedtls.port.els_pkc if MCUX_HW_DEVICE_RW612 || MCUX_HW_DEVICE_RW610
		default MCUX_COMPONENT_middleware.mbedtls.port.ksdk if MCUX_HW_DEVICE_MIMXRT1061 || MCUX_HW_DEVICE_MIMXRT1062
		default MCUX_COMPONENT_middleware.mbedtls.port.sssapi if MCUX_HW_DEVICE_MCXW716C || MCUX_HW_DEVICE_MCXW727C
	endchoice
endif

source "Kconfig.mcuxpresso"
```

## matter/zephyr/Kconfig
```kconfig
#
# Copyright 2026 NXP
# SPDX-License-Identifier: BSD-3-Clause

mainmenu "SE05x Demo Configuration"

source "Kconfig.zephyr"

#config CONSOLE
#    bool "Enable console handler"
#    default y
#
#config CONSOLE_HANDLER
#    bool "Enable console handler"
#    default y
#    select UART_CONSOLE
#    select SERIAL
#    select UART_INTERRUPT_DRIVEN
#
#config GPIO_INIT
#    bool "Enable GPIO"
#    default y
#    select GPIO
#
#config ENABLE_PROTECTION
#    bool "Enable memory and stack protection"
#    default y
#    select ARM_MPU
#    select HW_STACK_PROTECTION
#
#config ENABLE_TRUSTZONE
#    bool "Enable TrustZone secure execution"
#    default y
#    select TRUSTED_EXECUTION_SECURE
#
```
